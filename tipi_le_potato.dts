/dts-v1/;
/plugin/;

#include <dt-bindings/gpio/gpio.h>
#include <dt-bindings/gpio/meson-gxl-gpio.h>
#include <dt-bindings/interrupt-controller/irq.h>
#include <dt-bindings/interrupt-controller/meson-gic.h>

/ {
  compatible = "libretech,cc", "amlogic,s905x", "amlogic,meson-gxl";
  fragment@0 {
    target-path = "/";
    __overlay__ {
      tipi_gpio {
        compatible = "jedimatt42,tipi";
        status = "okay";
        label = "tipi";
        tipi-clk-gpio = <&gpio GPIOX_18 0>;
        tipi-rt-gpio = <&gpio GPIOX_6 0>;
        tipi-dout-gpio = <&gpio GPIOX_2 0>;
        tipi-le-gpio = <&gpio GPIOX_7 0>;
        tipi-din-gpio = <&gpio GPIOX_3 0>;
        tipi-cd-gpio = <&gpio GPIOX_4 0>;
        tipi-reset-gpio = <&gpio GPIOX_5 (GPIO_ACTIVE_LOW | GPIO_PULL_UP)>;
        interrupt-parent = <&gpio_intc>;
        interrupts = <MESON_GIC_GXL_GPIOX_5 IRQ_TYPE_EDGE_FALLING>;
      };
    };
  };
};
